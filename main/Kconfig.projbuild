## main/Kconfig.projbuild
```kconfig
menu "LedWall Configuration"
    config PROVISION_POP
        string "Proof-of-Possession"
        default "abcd1234"
        help
            Auto provisioning Proof-of-Possession

    config MDNS_HOSTNAME
        string "mDNS Hostname"
        default "ledwall"
        help
            Hostname to advertise via mDNS

    config ENABLE_CAM
        bool "Enable CAM Driver"
        default false

    config ENABLE_MQTT
        bool "Enable MQTT Interface"
        default false

    config ENABLE_REST
        bool "Enable http/REST Interface"
        default false

    config DATA_PIN
        int "Data PIN the LEDs are attached to"
        default 26

endmenu
```

## sdkconfig.defaults
```kconfig
CONFIG_HTTPD_MAX_REQ_HDR_LEN=1024
CONFIG_SPIFFS_OBJ_NAME_LEN=64
CONFIG_FATFS_LONG_FILENAME=y
CONFIG_FATFS_LFN_HEAP=y
CONFIG_ESPTOOLPY_FLASHSIZE_4MB=y
CONFIG_PARTITION_TABLE_CUSTOM=y
CONFIG_PARTITION_TABLE_CUSTOM_FILENAME="partition_table.csv"
CONFIG_PARTITION_TABLE_FILENAME="partition_table.csv"
CONFIG_BT_ENABLED=y

# for development purposes we allow updates over HTTP without certificate checks etc
CONFIG_OTA_ALLOW_HTTP=y

################################################################################
# LEDWall Features

#CONFIG_ENABLE_CAM=y
CONFIG_ENABLE_MQTT=y
CONFIG_ENABLE_REST=y
CONFIG_LEDWALL_SENSORS=y
CONFIG_LEDWALL_SENSOR_AHT10=y

# Laterne
#CONFIG_AHT10_PIN_SDA=5
#CONFIG_AHT10_PIN_SCL=4
# Wall
CONFIG_AHT10_PIN_SDA=21
CONFIG_AHT10_PIN_SCL=22

################################################################################
# EBLi Stuff

CONFIG_ENABLE_EBLI_FS=y
CONFIG_ENABLE_EBLI_WIFI=y
CONFIG_ENABLE_EBLI_MQTT=y
CONFIG_EBLI_MQTT_DEFAULT_BROKER="black-pearl"
CONFIG_EBLI_MQTT_DEFAULT_DEVICE_TOPIC="ledwall"
CONFIG_EBLI_MQTT_DEFAULT_GROUP_TOPIC="ledwalls"
CONFIG_ENABLE_EBLI_CONFIG_OTA=y
CONFIG_ENABLE_EBLI_CONFIG_MANAGER=y

################################################################################
# CAM Stuff

CONFIG_OV2640_SUPPORT=y
CONFIG_OV7725_SUPPORT=n
CONFIG_OV3660_SUPPORT=n
CONFIG_OV5640_SUPPORT=n

CONFIG_ESPTOOLPY_FLASHSIZE_4MB=y
CONFIG_RTCIO_SUPPORT_RTC_GPIO_DESC=y

#CONFIG_ESP32_SPIRAM_SUPPORT=y
#CONFIG_SPIRAM_CACHE_WORKAROUND=n
#CONFIG_SPIRAM_IGNORE_NOTFOUND=y
#CONFIG_SPIRAM_MEMTEST=n
```
